## build/conf/bblayers.conf
```bitbake
# LAYER_CONF_VERSION is increased each time build/conf/bblayers.conf
# changes incompatibly
LCONF_VERSION = "6"

BBPATH = "${TOPDIR}"
BBFILES ?= ""
METAROOT = "${TOPDIR}/.."

BBLAYERS ?= " \
  ${METAROOT}/poky/meta \
  ${METAROOT}/poky/meta-yocto \
  ${METAROOT}/poky/meta-yocto-bsp \
  ${METAROOT}/meta-ivi/meta-ivi \
  ${METAROOT}/meta-ivi/meta-ivi-bsp \
  "
BBLAYERS_NON_REMOVABLE ?= " \
  ${METAROOT}/poky/meta \
  ${METAROOT}/poky/meta-yocto \
  "
```
